## Kconfig
```kconfig
menu "Architecture"

source ./arch/Kconfig

endmenu

menu "Kernel"

source ./kernel/Kconfig

endmenu

menu "File systems"

source ./fs/Kconfig

endmenu


menu "Drivers"

source ./drivers/Kconfig

endmenu
```

## arch/Kconfig
```kconfig
choice
        prompt "Select target board"
        default ARCH_TAURUS

config ARCH_TAURUS
        bool "Taurus risc-v system"
        help
          Target the Taurus rv32i system made in roblox

config ARCH_MCXA153
        bool "NXP MCXA153 ARM Cortex-M MCU"
        help
          Target the MCXA153 FRDM development board

endchoice

config ARCH_TYPE
        string
        default "TAURUS" if ARCH_TAURUS
        default "ARMv8-M" if ARCH_MCXA153
        default "none"

config LTO
        bool "LTO(Link Time Optimization)"
        help
          Compile with LTO, Currently still experimental on ARM
config DEBUG
        bool "Build with debugging"
        depends on !ARCH_TAURUS
        help
          Build the kernel with debugging symbols and launch a gdb server. Not suported on Taurus
```

## drivers/Kconfig
```kconfig
config TTY_DRIVER
        bool "Generic TTY driver"

menuconfig USART_DRIVER
        bool "USART driver"
if USART_DRIVER

source ./drivers/USART/Kconfig

endif

config CM2_TILING_GPU
        bool "Tiling GPU driver"
        depends on ARCH_TAURUS

config CM2_BLOCK_DEV
        bool "Generic disk driver"
        depends on ARCH_TAURUS

config ST7920_DRIVER
        bool "ST7920 Display driver"
        depends on ARCH_MCXA153
```

## drivers/USART/Kconfig
```kconfig
config USART_DRIVER_CM2CON
        bool "cm2 console driver"
        depends on ARCH_TAURUS

config USART_DRIVER_MCXA
        bool "mcxa153 lpuart driver"
        depends on ARCH_MCXA153

config USART_TX_BUFFER_SIZE
        int "TX buffer size"
        default 16

config USART_RX_BUFFER_SIZE
        int "RX buffer size"
        default 16

config USART_MAX_COUNT
        int "USART Count"
        default 2
```

## fs/Kconfig
```kconfig
config FS_FATFS
        bool "FATFS Filesystem"
        help
          Select the FATFS file system wich implements a fat8 style filesystem.
config FS_ROMFS
        bool "ROMFS Filesystem"
        help
          Select the ROMFS filesystem which is a read only filesystem built into the kernel image, usefull for creating filesystems in flash.
```

## kconfig
```kconfig
menu "Architecture"

choice
        prompt "Select target board"
        default ARCH_TAURUS

config ARCH_TAURUS
        bool "Taurus risc-v system"
        help
          Target the Taurus rv32i system made in roblox

config ARCH_MCXA153
        bool "NXP MCXA153 ARM Cortex-M MCU"
        help
          Target the MCXA153 FRDM development board
endchoice

endmenu

menu "Init"

choice
        prompt "Select rootfs"

config ROOTFS_FATFS
        bool "FATFS"
        depends on FS_FATFS

config ROOTFS_ROMFS
        bool "ROMFS"
        depends on FS_ROMFS

endchoice

config ROOTFS_TYPE
        string
        default "fatfs" if ROOTFS_FATFS
        default "romfs" if ROOTFS_ROMFS
        default "none"

config ROOTFS_DEVNO
        int "rootfs device number"
        help
          This is the device number that identifies the device that the rootfs is mounted on.

config DEVFS_MOUNTPOINT
        string "DEVFS mountpoint"
        default "/dev"

config INIT_PATH
        string "Init binary path"
        default "/bin/sh"

config INIT_CONSOLE_DEVNO
        int "boot console device number"
        help
          This is the device number that identifies the output device for the boot console.

endmenu

menu "File systems"

config FS_FATFS
        bool "FATFS Filesystem"
        help
          Select the FATFS file system wich implements a fat8 style filesystem.
config FS_ROMFS
        bool "ROMFS Filesystem"
        help
          Select the ROMFS filesystem which is a read only filesystem built into the kernel image, usefull for creating filesystems in flash.

endmenu


menu "Drivers"

config CM2_TTY_DRIVER
        bool "Generic TTY driver"
        depends on ARCH_TAURUS

config CM2_TILING_GPU
        bool "Tiling GPU driver"
        depends on ARCH_TAURUS

config CM2_BLOCK_DEV
        bool "Generic disk driver"
        depends on ARCH_TAURUS


endmenu
```

## kernel/Kconfig
```kconfig
choice
        prompt "Select rootfs"

config ROOTFS_FATFS
        bool "FATFS"
        depends on FS_FATFS

config ROOTFS_ROMFS
        bool "ROMFS"
        depends on FS_ROMFS

endchoice

config ROOTFS_TYPE
        string
        default "fatfs" if ROOTFS_FATFS
        default "romfs" if ROOTFS_ROMFS
        default "none"

config ROOTFS_DEV_MAJ
        int "rootfs device major"
        help
          This is the major number of the device that contains the rootfs

config ROOTFS_DEV_MIN
        int "rootfs device minor"
        help
          This is the minor number of the device that contains the rootfs


config INIT_PATH
        string "Init binary path"
        default "/bin/sh"

config INIT_CONSOLE_DEVNO
        int "boot console device number"
        help
          This is the device number that identifies the output device for the boot console.
```
